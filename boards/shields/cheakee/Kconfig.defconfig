## boards/shields/cheakee/Kconfig.defconfig
```kconfig
# The left part is a central.
if SHIELD_CHEAKEE_LEFT

config ZMK_SPLIT
    default y

config ZMK_SPLIT_ROLE_CENTRAL
    default n

config ZMK_POINTING
    default y

endif

# The right is a peripheral.
if SHIELD_CHEAKEE_RIGHT

# Name must be less than 16 characters long!
config ZMK_KEYBOARD_NAME
    default "Cheakee"

config ZMK_BLE
    default y

config ZMK_SPLIT
    default y

config ZMK_SPLIT_ROLE_CENTRAL
    default y

config SPI
    default y

config INPUT
    default y

config PMW3610
    default y

config ZMK_POINTING
    default y

endif
```

## config/boards/shields/cheakee/Kconfig.defconfig
```kconfig
# The left part is a central.
if SHIELD_CHEAKEE_LEFT

# Name must be less than 16 characters long!
config ZMK_KEYBOARD_NAME
    default "Cheakee"

config ZMK_SPLIT
    default y

config ZMK_SPLIT_ROLE_CENTRAL
    default y

config ZMK_POINTING
    default y

endif

# The right is a peripheral.
if SHIELD_CHEAKEE_RIGHT

config ZMK_SPLIT
    default y

config ZMK_SPLIT_ROLE_CENTRAL
    default n

config SPI
    default y

config INPUT
    default y

config INPUT_PAW32XX
    default y

config ZMK_POINTING
    default y

config NFCT_PINS_AS_GPIOS
    default y

config ZMK_USB
    default n

endif
```

## config/boards/shields/cheakee/Kconfig.shield
```kconfig
config SHIELD_CHEAKEE_LEFT
    def_bool $(shields_list_contains,cheakee_left)

config SHIELD_CHEAKEE_RIGHT
    def_bool $(shields_list_contains,cheakee_right)
```

## config/west.yml
```yaml
manifest:
  remotes:
    - name: zmkfirmware
      url-base: https://github.com/zmkfirmware
    # Additional modules containing boards/shields/custom code can be listed here as well
    # See https://docs.zephyrproject.org/3.2.0/develop/west/manifest.html#projects
    - name: tomori-k
      url-base: https://github.com/tomori-k
    - name: zettaface
      url-base: https://github.com/zettaface
    - name: kot149
      url-base: https://github.com/kot149
  projects:
    - name: zmk
      remote: tomori-k
      revision: v2025.11.30
      import: app/west.yml
    - name: zmk-keyboards-cheakee
      remote: tomori-k
      revision: v2025.11.30
    - name: zmk-pmw3610-driver
      remote: tomori-k
      revision: v2025.11.30
    - name: zmk-behavior-soft-off-local
      remote: tomori-k
      revision: v2025.11.30
    - name: zmk-behavior-auto-capsword
      remote: tomori-k
      revision: v2025.12.24
    - name: zmk-input-processor-keybind
      remote: zettaface
      revision: main
    - name: zmk-scroll-snap
      remote: kot149
      revision: v1
  self:
    path: config
```
